/*
 * Shared keymap logic for Corne, Cornix split keyboards.
 *
 * Layers
 *   BASE: Standard QWERTY
 *   NAV:  Navigation
 *   NUM:  Numbers + Symbols
 *   FN:   Functions
 *
 * Requires (include BEFORE this file):
 *   #include <behaviors.dtsi>
 *   #include <dt-bindings/zmk/bt.h>
 *   #include <dt-bindings/zmk/keys.h>
 *   #include <dt-bindings/zmk/outputs.h>
 *   #include <zmk-helpers/helper.h>
 *   #include "<keyboard>.h"
 */

#pragma once

#define BASE 0
#define NAV  1
#define NUM  2
#define FN   3

#define ___     &trans
#define NAV_RET &lt NAV RET
#define NUM_F16 &lt NUM F16
#define HY(x)   &kp LC(LA(LG(LS(x))))
#define CW      &caps_word
#define BRI_DN  &kp C_BRI_DN
#define BRI_UP  &kp C_BRI_UP
#define PREV    &kp C_PREV
#define NEXT    &kp C_NEXT
#define VOL_DN  &kp C_VOL_DN
#define VOL_UP  &kp C_VOL_UP
#define MUTE    &kp C_MUTE
#define BOOT    &bootloader
#define RESET   &sys_reset
#define SLEEP   &soft_off
#define BT(x)   &bt BT_SEL x
#define BTC     &bt BT_CLR
#define BTCA    &bt BT_CLR_ALL
#define OUTT    &out OUT_TOG

&lt { flavor = "balanced"; };

#define NOSHIFT(NAME, BINDING) \
  ZMK_MOD_MORPH(NAME, bindings = <BINDING>, <BINDING>; \
                mods = <(MOD_LSFT)>;)
NOSHIFT(ns_n1,    &kp N1)
NOSHIFT(ns_n2,    &kp N2)
NOSHIFT(ns_n3,    &kp N3)
NOSHIFT(ns_n4,    &kp N4)
NOSHIFT(ns_n5,    &kp N5)
NOSHIFT(ns_n6,    &kp N6)
NOSHIFT(ns_n7,    &kp N7)
NOSHIFT(ns_n8,    &kp N8)
NOSHIFT(ns_n9,    &kp N9)
NOSHIFT(ns_n0,    &kp N0)
NOSHIFT(ns_minus, &kp MINUS)
NOSHIFT(ns_equal, &kp EQUAL)
NOSHIFT(ns_grave, &kp GRAVE)
NOSHIFT(ns_bslh,  &kp BSLH)

#define NOMODS(NAME, BINDING1, BINDING2) \
  ZMK_MOD_MORPH(NAME, bindings = <BINDING1>, <BINDING2>; \
                mods = <(MOD_LSFT|MOD_LCTL|MOD_LALT|MOD_LGUI)>; \
                keep-mods = <(MOD_LSFT|MOD_LCTL|MOD_LALT|MOD_LGUI)>;)

//    LT5 LT4 LT3 LT2 LT1 LT0 RT0 RT1 RT2 RT3 RT4 RT5
//    LM5 LM4 LM3 LM2 LM1 LM0 RM0 RM1 RM2 RM3 RM4 RM5
//    LB5 LB4 LB3 LB2 LB1 LB0 RB0 RB1 RB2 RB3 RB4 RB5
//                LH2 LH1 LH0 RH0 RH1 RH2

#define RMT_CORE \
  bindings = <&kp>, <&kp>; \
  tapping-term-ms = <300>; \
  quick-tap-ms = <0>; \
  hold-trigger-key-positions = < \
          LT4 LT3 LT2 LT1 LT0    \
      LM5 LM4 LM3 LM2 LM1 LM0    \
      LB5 LB4 LB3 LB2 LB1 LB0    \
                  LH2 LH1        \
  >;
ZMK_HOLD_TAP(rbmt, flavor = "balanced"; RMT_CORE)
NOMODS(rc_sqt, &rbmt RCTRL SQT, &kp SQT)
ZMK_HOLD_TAP(rmt, flavor = "hold-preferred"; RMT_CORE)
NOMODS(rs_rbkt, &rmt RSHFT RBKT, &kp RBKT)

ZMK_CONDITIONAL_LAYER(tri, NAV NUM, FN)

//              ╭─────────┬─────────┬─────────┬─────────┬─────────┬─────────╮
#define BASE_L1  &kp TAB   &kp Q     &kp W     &kp E     &kp R     &kp T
//              ├─────────┼─────────┼─────────┼─────────┼─────────┼─────────┤
#define BASE_L2  &kp LCTRL &kp A     &kp S     &kp D     &kp F     &kp G
//              ├─────────┼─────────┼─────────┼─────────┼─────────┼─────────┤
#define BASE_L3  &kp LSHFT &kp Z     &kp X     &kp C     &kp V     &kp B
//              ╰─────────────────────────────┼─────────┼─────────┼─────────┤
#define BASE_LT                                &kp LALT  &kp LGUI  &kp SPACE
//                                            ╰─────────┴─────────┴─────────╯

//              ╭─────────┬─────────┬─────────┬─────────┬─────────┬─────────╮
#define BASE_R1  &kp Y     &kp U     &kp I     &kp O     &kp P     &kp LBKT
//              ├─────────┼─────────┼─────────┼─────────┼─────────┼─────────┤
#define BASE_R2  &kp H     &kp J     &kp K     &kp L     &kp SEMI  &rc_sqt
//              ├─────────┼─────────┼─────────┼─────────┼─────────┼─────────┤
#define BASE_R3  &kp N     &kp M     &kp COMMA &kp DOT   &kp FSLH  &rs_rbkt
//              ├─────────┼─────────┼─────────┼─────────────────────────────╯
#define BASE_RT  NAV_RET   NUM_F16   &kp BSPC
//              ╰─────────┴─────────┴─────────╯

//             ╭─────────┬─────────┬─────────┬─────────┬─────────┬─────────╮
#define NAV_L1  ___       ___       ___       ___       ___       ___
//             ├─────────┼─────────┼─────────┼─────────┼─────────┼─────────┤
#define NAV_L2  ___       ___       ___       ___       ___       ___
//             ├─────────┼─────────┼─────────┼─────────┼─────────┼─────────┤
#define NAV_L3  ___       ___       ___       ___       ___       ___
//             ╰─────────────────────────────┼─────────┼─────────┼─────────┤
#define NAV_LT                                ___       ___       ___
//                                           ╰─────────┴─────────┴─────────╯

//             ╭─────────┬─────────┬─────────┬─────────┬─────────┬─────────╮
#define NAV_R1  &kp DEL   HY(N1)    HY(N2)    &tog NAV  &kp RET   ___
//             ├─────────┼─────────┼─────────┼─────────┼─────────┼─────────┤
#define NAV_R2  &kp LEFT  &kp DOWN  &kp UP    &kp RIGHT &kp SPACE &kp SQT
//             ├─────────┼─────────┼─────────┼─────────┼─────────┼─────────┤
#define NAV_R3  &kp HOME  &kp PG_DN &kp PG_UP &kp END   &kp INS   &kp RBKT
//             ├─────────┼─────────┼─────────┼─────────────────────────────╯
#define NAV_RT  ___       ___       ___
//             ╰─────────┴─────────┴─────────╯

//             ╭─────────┬─────────┬─────────┬─────────┬─────────┬─────────╮
#define NUM_L1  &kp ESC   &kp EXCL  &kp AT    &kp HASH  &kp DLLR  &kp PRCNT
//             ├─────────┼─────────┼─────────┼─────────┼─────────┼─────────┤
#define NUM_L2  ___       &ns_n1    &ns_n2    &ns_n3    &ns_n4    &ns_n5
//             ├─────────┼─────────┼─────────┼─────────┼─────────┼─────────┤
#define NUM_L3  ___       CW        &kp UNDER &ns_minus &ns_equal &kp PLUS
//             ╰─────────────────────────────┼─────────┼─────────┼─────────┤
#define NUM_LT                                ___       ___       ___
//                                           ╰─────────┴─────────┴─────────╯

//             ╭─────────┬─────────┬─────────┬─────────┬─────────┬─────────╮
#define NUM_R1  &kp CARET &kp AMPS  &kp STAR  &kp LPAR  &kp RPAR  &kp TILDE
//             ├─────────┼─────────┼─────────┼─────────┼─────────┼─────────┤
#define NUM_R2  &ns_n6    &ns_n7    &ns_n8    &ns_n9    &ns_n0    &ns_grave
//             ├─────────┼─────────┼─────────┼─────────┼─────────┼─────────┤
#define NUM_R3  &ns_bslh  &kp PIPE  ___       ___       ___       ___
//             ├─────────┼─────────┼─────────┼─────────────────────────────╯
#define NUM_RT  ___       ___       ___
//             ╰─────────┴─────────┴─────────╯

//            ╭─────────┬─────────┬─────────┬─────────┬─────────┬─────────╮
#define FN_L1  &kp F1    &kp F2    &kp F3    &kp F4    &kp F5    &kp F6
//            ├─────────┼─────────┼─────────┼─────────┼─────────┼─────────┤
#define FN_L2  ___       BRI_DN    BRI_UP    PREV      NEXT      VOL_UP
//            ├─────────┼─────────┼─────────┼─────────┼─────────┼─────────┤
#define FN_L3  ___       BOOT      RESET     SLEEP     MUTE      VOL_DN
//            ╰─────────────────────────────┼─────────┼─────────┼─────────┤
#define FN_LT                                ___       ___       &kp C_PP
//                                          ╰─────────┴─────────┴─────────╯

//            ╭─────────┬─────────┬─────────┬─────────┬─────────┬─────────╮
#define FN_R1  &kp F7    &kp F8    &kp F9    &kp F10   &kp F11   &kp F12
//            ├─────────┼─────────┼─────────┼─────────┼─────────┼─────────┤
#define FN_R2  BT(0)     BT(1)     BT(2)     BT(3)     BT(4)     OUTT
//            ├─────────┼─────────┼─────────┼─────────┼─────────┼─────────┤
#define FN_R3  BTC       BTCA      SLEEP     RESET     BOOT      ___
//            ├─────────┼─────────┼─────────┼─────────────────────────────╯
#define FN_RT  ___       ___       ___
//            ╰─────────┴─────────┴─────────╯
